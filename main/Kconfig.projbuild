## main/Kconfig.projbuild
```kconfig
menu "Quota Orbit wish sync"
    config ORBIT_WISH_URL
        string "HTTPS URL of the approved Passport wish endpoint"
        default ""
        help
            Empty disables transport until the shared-count service is deployed.
            Never use the browser endpoint by forging an Origin header.
endmenu
```
